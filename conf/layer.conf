## conf/layer.conf
```bitbake
# We have a conf and classes directory, add to BBPATH
BBPATH .= ":${LAYERDIR}"

# We have recipes-* directories, add to BBFILES
BBFILES += "${LAYERDIR}/recipes-*/*/*.bb \
            ${LAYERDIR}/recipes-*/*/*.bbappend"

BBFILE_COLLECTIONS += "meta-azure-tdx"
BBFILE_PATTERN_meta-azure-tdx = "^${LAYERDIR}/"
BBFILE_PRIORITY_meta-azure-tdx = "6"

LAYERDEPENDS_meta-azure-tdx = "core"
LAYERSERIES_COMPAT_meta-azure-tdx = "styhead"
```
